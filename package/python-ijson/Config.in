## package/python-ijson/Config.in
```kconfig
config BR2_PACKAGE_PYTHON_IJSON
	bool "python-ijson"
	help
	  Iterative JSON parser with standard Python iterator
	  interfaces.

	  https://github.com/ICRAR/ijson
```

## package/python-jsondiff/Config.in
```kconfig
config BR2_PACKAGE_PYTHON_JSONDIFF
	bool "python-jsondiff"
	help
	  Diff JSON and JSON-like structures in Python.

	  https://github.com/ZoomerAnalytics/jsondiff
```
